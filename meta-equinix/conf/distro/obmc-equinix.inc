## meta-equinix/conf/distro/obmc-equinix.inc
```bitbake
# include CVE-2019-6260 mitigation patches
require conf/distro/include/phosphor-isolation.inc
```

## meta-equinix/meta-e3c246d4i/conf/machine/equinix-e3c246d4i.conf
```bitbake
KMACHINE = "aspeed"
KERNEL_DEVICETREE = "${KMACHINE}-${MACHINE}.dtb"

UBOOT_MACHINE = "ast_g5_phy_config"

FLASH_SIZE = "32768"

require conf/machine/include/ast2500.inc
require conf/machine/include/obmc-bsp-common.inc

PREFERRED_PROVIDER_virtual/obmc-fan-mgmt = "packagegroup-equinix-apps"
PREFERRED_PROVIDER_virtual/obmc-chassis-mgmt = "packagegroup-equinix-apps"
PREFERRED_PROVIDER_virtual/obmc-flash-mgmt = "packagegroup-equinix-apps"
PREFERRED_PROVIDER_virtual/obmc-system-mgmt = "packagegroup-equinix-apps"

KERNEL_FEATURES_remove = "phosphor-gpio-keys"
KERNEL_FEATURES_remove = "phosphor-vlan"

VIRTUAL-RUNTIME_obmc-host-state-manager = "x86-power-control"
VIRTUAL-RUNTIME_obmc-chassis-state-manager = "x86-power-control"
```
